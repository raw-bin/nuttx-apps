## examples/hello_pcre2/Kconfig
```kconfig
config EXAMPLES_HELLO_PCRE2
	tristate "\"Hello, pcre2!\" example (pcre2)"
	select ARCH_SETJMP_H
	select REGEX_PCRE2
	default n
	---help---
		Enable the \"Hello, pcre2!\" example

if EXAMPLES_HELLO_PCRE2

config EXAMPLES_HELLO_PCRE2_PROGNAME
	string "Program name"
	default "hello_pcre2"
	---help---
		This is the name of the program that will be used when the NSH ELF
		program is installed.

config EXAMPLES_HELLO_PCRE2_PRIORITY
	int "Hello task priority"
	default 100

config EXAMPLES_HELLO_PCRE2_STACKSIZE
	int "pcre2 Hello stack size"
	default DEFAULT_TASK_STACKSIZE

endif
```

## examples/hello_tinygc/Kconfig
```kconfig
config EXAMPLES_HELLO_TINYGC
	tristate "\"Hello, tinygc!\" example (tinygc)"
	select ARCH_SETJMP_H
	select GCS_TINYGC
	default n
	---help---
		Enable the \"Hello, tinygc!\" example

if EXAMPLES_HELLO_TINYGC

config EXAMPLES_HELLO_TINYGC_PROGNAME
	string "Program name"
	default "hello_tinygc"
	---help---
		This is the name of the program that will be used when the NSH ELF
		program is installed.

config EXAMPLES_HELLO_TINYGC_PRIORITY
	int "Hello task priority"
	default 100

config EXAMPLES_HELLO_TINYGC_STACKSIZE
	int "tinygc Hello stack size"
	default DEFAULT_TASK_STACKSIZE

endif
```

## gcs/tinygc/Kconfig
```kconfig
config GCS_TINYGC
  tristate "Support for the tinygc garbage collector"
  default n
  depends on ALLOW_GPL_COMPONENTS
```

## regex/pcre2/Kconfig
```kconfig
config REGEX_PCRE2
  tristate "Support for PCRE2 Perl Compatible Regular Expressions"
  default n
  depends on ALLOW_BSD_COMPONENTS
```
